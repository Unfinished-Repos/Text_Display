/*  Made by: Andrew Friedman
 *  Date: 7/5/2019
 *  TODO:
    - Support other font libraries
    - Support non square dimensions
    - Make it possible to display all lights
    - Consistent var names
    - Optimize
*/

#include <Adafruit_NeoPixel.h>

#define PIN 6
#define NUMPIXELS 100

Adafruit_NeoPixel Strip = Adafruit_NeoPixel(NUMPIXELS, PIN, NEO_GRB + NEO_KHZ800);

byte char_library[96][8]  = { // Convert to 95 ints?
  { 0x00, 0x00, 0x00, 0x00, 0x00, 0x00, 0x00, 0x00},   // U+0020 ( ) 
  { 0x18, 0x3C, 0x3C, 0x18, 0x18, 0x00, 0x18, 0x00},   // U+0021 (!)
  { 0x36, 0x36, 0x00, 0x00, 0x00, 0x00, 0x00, 0x00},   // U+0022 (")
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  { 0x6E, 0x3B, 0x00, 0x00, 0x00, 0x00, 0x00, 0x00},   // U+007E (~)
};

void setup() {
  Serial.begin(9600);
  Strip.begin();
  Strip.setBrightness(100);
  Strip.show();
}

void loop() {
  SwipeText("Made by Andrew Friedman.");
}

int Linear_to_Matrix (int Input) { //Rearranges number
  int x = Input % (int)sqrt(NUMPIXELS);
  int y = floor(Input / sqrt(NUMPIXELS));
  int temp_x = x; //Optimize?
  if (x % 2 == 0) {
    x = sqrt(NUMPIXELS) - y - 1;
  } else {
    x = y;
  }
  y = sqrt(NUMPIXELS) - temp_x - 1;
  x = floor(x / sqrt(NUMPIXELS)) + (sqrt(NUMPIXELS) - (x % (int)sqrt(NUMPIXELS)) - 1); //Optimize?
  return y * sqrt(NUMPIXELS) + x;
}

String Base10toBinary(int input) { // TODO: make this an int-array to save space
  String output;
  while (input != 0) {
    output = (input % 2 == 0 ? "0" : "1") + output;
    input /= 2;
  }
  while (output.length() < sqrt(NUMPIXELS)) {
    output = "0" + output;
    if (output.length() >= 8) { // 8 = char length
      output += "0";
    }
  }
  return output;
}

void StringToASCII (String Input) { // prints char to char
  for (char x : Input) {
    Wipe();
    ASCII((int)x - 32, 0); //start the ascii table with the 32nd char
    Strip.show();
    delay(1000);
  }
}

void SwipeText (String Input) { // prints scrolling
  int b = 8*Input.length();
  for (int a = (sqrt(NUMPIXELS)-1)*-1; a <= b; a++) {
    Wipe();
    for (int i = (a-1)/8; i < (a+16)/8; i++) {
       if (Input[i]) { // filter
        ASCII((int)Input[i]-32, a-(8*i));
       }
    }
    Strip.show();
    delay(150);
  }
}

void Wipe () {
  for (int a = 0; a < NUMPIXELS; a++) {
    Strip.setPixelColor(a, Strip.Color(0, 0, 0));
  }
}

void ASCII (int Letter, int offset) { // Prints single char
  int Coordinates[NUMPIXELS] = {};
  
  // Converts ASCII to coordinates
  int counter = 0;
  for (int i = 0; i < sizeof(char_library[Letter]); i++) {
    String Values = Base10toBinary(char_library[Letter][i]);
    for (int a = 0; a < Values.length(); a++) {
      int pos = i * (int)sqrt(NUMPIXELS) + a + ceil((sqrt(NUMPIXELS) - 8) / 2) * sqrt(NUMPIXELS);
      if (Values[a] == '1') {
        if (!((pos % 10) + offset > 9) && !((pos % 10) + offset < 0)) { // filter
          Coordinates[counter] = pos + offset;
          counter++;
        }
      }
    }
  }

  // convert & assign coordinates
  for (int i : Coordinates) {
    if (i != 0) { // TODO: Find better solution
      Strip.setPixelColor(Linear_to_Matrix(i), Strip.Color(0, 150, 0));
    }
  }
}
